//This is set up to use a 128x64 I2C screen, as available
//
//For wiring details see http://youtu.be/XHDNXXhg3Hg


#include <SPI.h>
#include <Wire.h>
#include <Adafruit_GFX.h>
#include <Adafruit_SSD1306.h>

#define SCREEN_WIDTH 128 // OLED display width, in pixels
#define SCREEN_HEIGHT 64 // OLED display height, in pixels

// Declaration for an SSD1306 display connected to I2C (SDA, SCL pins)
#define SCL_PIN SCL
#define SDA_PIN SDA
#define OLED_RESET 3 // Reset pin # (or -1 if sharing Arduino reset pin)
#define SCREEN_ADDRESS 0x3C ///< See datasheet for Address; 0x3D for 128x64, 0x3C for 128x32
Adafruit_SSD1306 display(SCREEN_WIDTH, SCREEN_HEIGHT, &Wire, OLED_RESET);

#if (SSD1306_LCDHEIGHT != 64)
//  error("Height incorrect, please fix Adafruit_SSD1306.h!");
#endif

/********************************************/

#define CHARWIDTH           5
#define CHARHEIGHT          8
#define AXISWIDTH           0                   // axis will show two-pixel wide graph ticks, then an empty column
#define VISIBLEVALUEPIXELS  (128 - AXISWIDTH)         // the number of samples visible on screen
#define NUMVALUES           (2 * VISIBLEVALUEPIXELS)  // the total number of samples (take twice as many as visible, to help find trigger point

#define TRIGGER_ENABLE_PIN       10  // set this pin high to enable trigger
#define SCREEN_UPDATE_ENABLE_PIN 9 // set this pin high to freeze screen

byte values[NUMVALUES];           // stores read analog values mapped to 0-63
int pos = 0;                      // the next position in the value array to read
int count = 0;                    // the total number of times through the loop
unsigned long readStartTime = 0;  // time when the current sampling started
unsigned long lastreadStartTime = 0;
unsigned long totalSampleTime = 0;
int sampleRate = 1;              // A value of 1 will sample every time through the loop, 5 will sample every fifth time etc.

const int voutPin = 3;
const int VOLT = 3.3; // 3.3Vを電源とした場合
const int ANALOG_MAX = 1023; // ESP32の場合
int poti = 100;
int poti2 = 0;

/********************************************/

// Draws a printf style string at the current cursor position
void displayln(const char* format, ...)
{
  char buffer[32];
  
  va_list args;
  va_start(args, format);
  vsprintf(buffer, format, args);
  va_end(args);
  
  int len = strlen(buffer);
  for (uint8_t i = 0; i < len; i++) {
    display.write(buffer[i]);
  }
}

// Draws the graph ticks for the vertical axis
void drawAxis()
{  
  // graph ticks
  for (int x = 0; x < 2; x++) {
    display.drawPixel(x,  0, WHITE);
    display.drawPixel(x, 13, WHITE);
    display.drawPixel(x, 26, WHITE);
    display.drawPixel(x, 38, WHITE);
    display.drawPixel(x, 50, WHITE);
    display.drawPixel(x, 63, WHITE);  
  }
}

// Draws the sampled values
void drawValues()
{
  int start = 0;
  
  if ( digitalRead(TRIGGER_ENABLE_PIN) ) {
    // Find the first occurence of zero
    for (int i = 0; i < NUMVALUES; i++) {
      if ( values[i] == 40 ) {
        // Now find the next value that is not zero
        for (; i < NUMVALUES; i++) {
          if ( values[i] > 40 ) {
            start = i;
            break;
          }
        }
        break;
      }
    }    
    // If the trigger point is not within half of our values, we will 
    // not have enough sample points to show the wave correctly
    if ( start >= VISIBLEVALUEPIXELS )
      return;
  }
  
  for (int i = 0; i < VISIBLEVALUEPIXELS; i++) {
    display.drawPixel(i + AXISWIDTH, 0 + (values[i + start]), WHITE);
  }
}

// Shows the time taken to sample the values shown on screen
void drawFrameTime(unsigned long us)
{
  //display.setCursor(9 * CHARWIDTH, 7 * CHARHEIGHT - 2); // almost at bottom, approximately centered
  display.setCursor(9 * CHARWIDTH, 0); // almost at bottom, approximately centered
  displayln("%ld us", us);
}

void drawFrameFreq(unsigned long us, unsigned int magni)
{
  //display.setCursor(9 * CHARWIDTH, 7 * CHARHEIGHT - 2); // almost at bottom, approximately centered
  display.setCursor(3 * CHARWIDTH, 0); // almost at bottom, approximately centered
  displayln("%ldx", (5-magni));
  display.setCursor(15 * CHARWIDTH, 0); // almost at bottom, approximately centered
  displayln("%ld Hz", us);
}

/********************************************/

void setup() {
  analogReadResolution(10);
  
  Serial.begin(9600);
  Serial.println("starting display");
  // Set up the display
  if(!display.begin(SSD1306_SWITCHCAPVCC, SCREEN_ADDRESS)) {
    Serial.println(F("SSD1306 allocation failed"));
    for(;;); // Don't proceed, loop forever
  }
  // Clear the buffer.
  display.clearDisplay();
  display.display();
  delay(200);  
  display.setTextColor(WHITE);
  //showLogo_hackteria();
  delay(100);
  showLogo_tripton();
  delay(3000);
  showLogo_coconut();
  delay(1000); 
  
  display.setTextSize(1);
  pinMode(TRIGGER_ENABLE_PIN, INPUT_PULLUP);
  pinMode(SCREEN_UPDATE_ENABLE_PIN, INPUT_PULLUP);
  Serial.println("finsihed setup");
}

/********************************************/

void loop() {
  
  //Serial.println("start loop");

  // If a sampling run is about to start, record the start time
  if ( pos == 0 ) {
    readStartTime = micros();
    Serial.println(poti2);
    Serial.println(values[0]);
  }
  unsigned long diff = readStartTime - lastreadStartTime;

  if (diff >= 50000 + (poti * 100)) {
    //Serial.println(diff);
    //values[pos++] = ((3 * (analogRead(voutPin) >> 0))/4)-365; // shifting right by 4 efficiently maps 0-1023 range and divide to 0-47
    //values[pos++] = ((3 * (analogRead(voutPin) >> poti2))/4)- (20 << poti2);
    values[pos++] = map(analogRead(voutPin),ANALOG_MAX/2-(16<<poti2),ANALOG_MAX/2+(16<<poti2),63,16);     
    //values[pos++] = (analogRead(voutPin) >> (poti2+1)) - (20 * (poti2));
    delayMicroseconds(poti>>2);    
  }
  // If this iteration is one we want a sample for, take the sample
  //if ( (++count) % (sampleRate) == 0 ) values[pos++] = analogRead(voutPin) >> 4; // shifting right by 4 efficiently maps 0-1023 range to 0-63   
  
  // If we have filled the sample buffer, display the results on screen
  if ( pos >= NUMVALUES ) {
    if ( (++count) == 1 ){
    poti = analogRead(A2);
    poti2 = map(analogRead(A6),0,1023,5,0);
    lastreadStartTime = micros();
    
    // Measure how long the run took
    totalSampleTime = (micros() - readStartTime) / 2;     // Divide by 2 because we are taking twice as many samples as are shown on the screen
    unsigned long totalSampleFreq = 1000000 / totalSampleTime;
    if ( digitalRead(SCREEN_UPDATE_ENABLE_PIN) ) {
      // Display the data on screen   
      display.clearDisplay();
      //drawAxis();
      drawValues();
      //drawFrameTime(totalSampleTime);
      drawFrameFreq(totalSampleFreq, poti2);
      display.display();
      delayMicroseconds(100);
    }
       
    // Reset values for the next sampling run
    pos = 0;
    count = 0;
    //Serial.println("did it once");
    }
  }
}

const unsigned char hackteria_logo [] PROGMEM = {
  // 'hackteria_logo, 128x64px
  0x00, 0x00, 0x00, 0x00, 0x00, 0x00, 0x00, 0x00, 0x00, 0x00, 0x00, 0x00, 0x00, 0x00, 0x00, 0x00, 
  0x00, 0x00, 0x00, 0x00, 0x00, 0x00, 0x00, 0x00, 0x00, 0x00, 0x00, 0x00, 0x00, 0x00, 0x00, 0x00,
  0x00, 0x00, 0x00, 0x00, 0x00, 0x00, 0x00, 0x00, 0x00, 0x00, 0x00, 0x00, 0x00, 0x00, 0x00, 0x00, 
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  0x00, 0x00, 0x00, 0x00, 0x00, 0x00, 0x00, 0x7f, 0xf8, 0x00, 0x00, 0x00, 0x00, 0x00, 0x00, 0x00
};
const unsigned char BITW_matrix [] PROGMEM = {
  // 128,96
  0x00, 0x00, 0x00, 0x00, 0x00, 0x00, 0x00, 0x00, 0x00, 0x00, 0x00, 0x00, 0x00, 0x00, 0x00, 0x00, 
	0x00, 0x00, 0x00, 0x00, 0x00, 0x00, 0x00, 0x00, 0x00, 0x00, 0x00, 0x00, 0x00, 0x00, 0x00, 0x00, 
	0x00, 0x00, 0x00, 0x00, 0x00, 0x00, 0x00, 0x00, 0x00, 0x00, 0x00, 0x00, 0x00, 0x00, 0x00, 0x00, 
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	0x00, 0x00, 0x00, 0x01, 0x00, 0x00, 0x00, 0x00, 0x04, 0x00, 0x00, 0x00, 0x00, 0x00, 0x80, 0x00
};
// 'cocologo', 68x60px
const unsigned char cocologo [] PROGMEM = {
	0x00, 0x00, 0x00, 0x07, 0xfe, 0x00, 0x00, 0x00, 0x00, 0x00, 0x00, 0x00, 0x07, 0xfe, 0x00, 0x00, 
	0x00, 0x00, 0x00, 0x00, 0x00, 0x07, 0xfe, 0x00, 0x00, 0x00, 0x00, 0x00, 0x00, 0x00, 0x07, 0xfe, 
	0x00, 0x00, 0x00, 0x00, 0x00, 0x00, 0x00, 0x0f, 0xff, 0x00, 0x00, 0x00, 0x00, 0x00, 0x00, 0x00, 
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	0x0f, 0x80, 0x00, 0x00, 0x0c, 0x00, 0x00, 0x00, 0x00, 0x03, 0x00, 0x00
};

// 'cocologo', 54x48px
const unsigned char cocologo_sm [] PROGMEM = {
	0x00, 0x00, 0x01, 0xfe, 0x00, 0x00, 0x00, 0x00, 0x00, 0x01, 0xfe, 0x00, 0x00, 0x00, 0x00, 0x00, 
	0x01, 0xfe, 0x00, 0x00, 0x00, 0x00, 0x00, 0x03, 0xff, 0x00, 0x00, 0x00, 0x00, 0x00, 0x03, 0xff, 
	0x00, 0x00, 0x00, 0x00, 0x30, 0x03, 0xff, 0x00, 0x30, 0x00, 0x00, 0x78, 0x03, 0xff, 0x00, 0x78, 
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	0xfe, 0x00, 0x00, 0xf8, 0x00, 0x00, 0x00, 0x7c, 0x00, 0x00, 0x70, 0x00, 0x00, 0x00, 0x38, 0x00
};

// 'triptonlogo', 91x64px
const unsigned char triptonlogo [] PROGMEM = {
	0x00, 0x00, 0x00, 0x00, 0x00, 0x00, 0x00, 0x00, 0x00, 0x00, 0x00, 0x00, 0x00, 0x00, 0x00, 0x00, 
	0x00, 0x00, 0x00, 0x00, 0x00, 0x00, 0x00, 0x00, 0x00, 0x00, 0x00, 0x00, 0x00, 0x00, 0x00, 0x00, 
	0x00, 0x00, 0x00, 0x00, 0x00, 0x00, 0x00, 0x00, 0x1f, 0xff, 0xfc, 0x00, 0x00, 0x00, 0x00, 0x00, 
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	0x00, 0x00, 0x00, 0x00, 0x00, 0x00, 0x00, 0x00, 0x00, 0x00, 0x00, 0x00, 0x00, 0x00, 0x00, 0x00
};

void showLogo_hackteria(){
  display.clearDisplay(); // Make sure the display is cleared
  display.drawBitmap(0, 0, hackteria_logo, 128, 64, WHITE);  
  display.setTextSize(2);
  display.setTextColor(WHITE);
  display.setCursor(11,0);
  display.println("HACKTERIA");
  // Update the display
  display.display();
  delay(30);
}

void showLogo_coconut(){
  display.clearDisplay(); // Make sure the display is cleared
  display.drawBitmap(38, 16, cocologo_sm, 54, 48, WHITE);  
  display.setTextSize(1);
  display.setTextColor(WHITE);
  display.setCursor(0,0);
  display.println("Center for Alternativ");
  display.setCursor(0,8);
  display.println("  Coconut   Research");
  // Update the display
  display.display();
  delay(30);
}

void showLogo_tripton(){
  display.clearDisplay(); // Make sure the display is cleared 
  display.drawBitmap(0, 0, BITW_matrix, 128, 96, WHITE);  
  // Update the display
  display.display();
  delay(30);
}